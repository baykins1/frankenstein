## prj.conf
```kconfig
# Basic Application Functionality
CONFIG_GPIO=y

# Generic networking options
CONFIG_NETWORKING=y
CONFIG_NET_L2_OPENTHREAD=y
CONFIG_NET_UDP=y # <-- Enable UDP

# Network shell and logging
CONFIG_SHELL=y
CONFIG_OPENTHREAD_SHELL=y
CONFIG_SHELL_ARGC_MAX=26
CONFIG_SHELL_CMD_BUFF_SIZE=416
CONFIG_LOG=y
CONFIG_LOG_DEFAULT_LEVEL=3

# Enable OpenThread features set
CONFIG_OPENTHREAD_NORDIC_LIBRARY_MASTER=y
CONFIG_OPENTHREAD_THREAD_VERSION_1_2=y

# Required for nRF52840 DK
CONFIG_OPENTHREAD_FTD=y
CONFIG_OPENTHREAD_MTD=n

# Settings Storage
CONFIG_SETTINGS=y
CONFIG_PM_PARTITION_SIZE_SETTINGS_STORAGE=0x8000

# --- USB CDC-ACM (Virtual COM Port) Configuration ---
# Enable the main USB device stack
CONFIG_USB_DEVICE_STACK=y

# Give your device a recognizable name in Windows Device Manager
CONFIG_USB_DEVICE_PRODUCT="Zephyr OT CLI Argon"

# Enable the specific class for a virtual COM port
CONFIG_USB_CDC_ACM=y

# Enable the shell to detect when a terminal connects
CONFIG_UART_LINE_CTRL=y

# --- Console and Shell Backend Configuration ---
# Set the shell to use a serial backend (which will now be the USB VCOM)
CONFIG_SHELL_BACKEND_SERIAL=y
CONFIG_UART_CONSOLE=y

# Disable RTT to avoid confusion and ensure output goes to USB
CONFIG_USE_SEGGER_RTT=n
CONFIG_SHELL_BACKEND_RTT=n
CONFIG_LOG_BACKEND_RTT=n
```

## boards/particle_argon.overlay
```dts
/*
* Devicetree overlay for enabling USB CDC ACM (Virtual COM Port)
* on the Particle Argon's USB-C connector.
*/

/ {
    chosen {
        /* Tell the Zephyr shell to use the virtual USB UART as its backend */
        zephyr,shell-uart = &cdc_acm_uart0;
    };
};

/* Find the main USB device controller node */
&zephyr_udc0 {
    /* Define a new virtual UART device that uses the CDC ACM class */
    cdc_acm_uart0: cdc_acm_uart_0 {
        compatible = "zephyr,cdc-acm-uart";
        label = "CDC_ACM_0";
    };
};
```

## src/main.c
```c
/*
 * =================================================================
 * == COMPLETE main.c for Node (RAK/Argon)                        ==
 * =================================================================
 */
#include <zephyr/kernel.h>
#include <zephyr/device.h>
#include <zephyr/devicetree.h>
#include <zephyr/logging/log.h>
#include <stdio.h> // Needed for snprintf

#include <zephyr/net/openthread.h>
#include <openthread/udp.h>
#include <openthread/message.h>
#include <openthread/instance.h>
#include <openthread/platform/radio.h> // Needed for otPlatRadioGetIeeeEui64

LOG_MODULE_REGISTER(ot_node, CONFIG_LOG_DEFAULT_LEVEL);

// --- Port Definitions ---
#define HELLO_PORT 1235           // Port for sending "hello" reports
#define NODE_COMMAND_PORT 1236    // Port for listening for "start/stop" commands

// --- Global State ---
static bool is_reporting = false; // Controls if we are sending hello messages

// --- UDP Sockets ---
static otUdpSocket command_socket;

// --- Unique ID Function ---
void get_unique_id_string(char *id_buffer, size_t buffer_size)
{
    otInstance *p_ot_instance = openthread_get_default_instance();
    const uint8_t *mac_addr = otPlatRadioGetIeeeEui64(p_ot_instance);
    // Get the last 2 bytes (4 hex characters) of the MAC address
    snprintf(id_buffer, buffer_size, "%02x%02x", mac_addr[6], mac_addr[7]);
}

// --- Hello Message Sender ---
void send_hello_to_leader(void)
{
    otError error;
    otMessage *message;
    otMessageInfo messageInfo;
    otInstance *p_ot_instance = openthread_get_default_instance();
    otUdpSocket udpSocket;

    char unique_id[5];
    char hello_payload[20];

    get_unique_id_string(unique_id, sizeof(unique_id));
    snprintf(hello_payload, sizeof(hello_payload), "hello-%s", unique_id);

    memset(&messageInfo, 0, sizeof(messageInfo));
    
    // Get the Leader/Border Router's Anycast address from the Thread network data
    error = otThreadGetLeaderRloc(p_ot_instance, &messageInfo.mPeerAddr);
    if (error != OT_ERROR_NONE) {
        LOG_ERR("Cannot get Leader address, is network formed?");
        return;
    }
    messageInfo.mPeerPort = HELLO_PORT;

    message = otUdpNewMessage(p_ot_instance, NULL);
    if (message) {
        otMessageAppend(message, hello_payload, strlen(hello_payload));
        otUdpOpen(p_ot_instance, &udpSocket, NULL, NULL);
        otUdpSend(p_ot_instance, &udpSocket, message, &messageInfo);
        otUdpClose(p_ot_instance, &udpSocket);
    }
}

// --- Command Listener Callback ---
void command_receive_callback(void *aContext, otMessage *aMessage, const otMessageInfo *aMessageInfo)
{
    OT_UNUSED_VARIABLE(aContext);
    OT_UNUSED_VARIABLE(aMessageInfo);

    char command_buffer[10];
    int length = otMessageRead(aMessage, otMessageGetOffset(aMessage), command_buffer, sizeof(command_buffer) - 1);
    command_buffer[length] = '\0';

    if (strcmp(command_buffer, "start") == 0) {
        LOG_INF("'start' command received. Beginning to report.");
        is_reporting = true;
    } else if (strcmp(command_buffer, "stop") == 0) {
        LOG_INF("'stop' command received. Halting reports.");
        is_reporting = false;
    }
    otMessageFree(aMessage);
}

// --- Command Listener Setup ---
void setup_command_listener(void)
{
    otError error;
    otSockAddr sockaddr;
    otInstance *p_ot_instance = openthread_get_default_instance();

    memset(&sockaddr, 0, sizeof(sockaddr));
    sockaddr.mPort = NODE_COMMAND_PORT;

    error = otUdpOpen(p_ot_instance, &command_socket, command_receive_callback, NULL);
    if (error != OT_ERROR_NONE) {
        LOG_ERR("Failed to open command UDP socket: %d", error);
        return;
    }

    error = otUdpBind(p_ot_instance, &command_socket, &sockaddr, OT_NETIF_THREAD);
     if (error != OT_ERROR_NONE) {
        LOG_ERR("Failed to bind command UDP socket: %d", error);
        return;
    }
    LOG_INF("Node command listener started on port %d", NODE_COMMAND_PORT);
}

// --- Main ---
int main(void)
{
    LOG_INF("Starting OpenThread Node Application");

    if (openthread_start(openthread_get_default_context()) != 0) {
        LOG_ERR("Failed to start OpenThread");
        return -1;
    }

    setup_command_listener();
    LOG_INF("Node initialized. Waiting for commands.");

    while (1) {
        // Only send if we are told to and are fully connected to the network
        if (is_reporting && (otThreadGetDeviceRole(openthread_get_default_instance()) > OT_DEVICE_ROLE_DISABLED)) {
            send_hello_to_leader();
        }
        k_sleep(K_SECONDS(1));
    }
    return 0; // Should not be reached
}
```
