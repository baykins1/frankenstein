## prj.conf
```kconfig
# =================================================================
# ==        STEP 1 (Final Test): Bare Metal Shell Test         ==
# =================================================================

# --- Give the main thread enough memory to not crash ---
CONFIG_MAIN_STACK_SIZE=2048

# --- Base Kernel & USB ---
CONFIG_USB_DEVICE_STACK=y
CONFIG_USB_DEVICE_PRODUCT="DK Shell Works!"
CONFIG_USB_CDC_ACM=y
CONFIG_UART_LINE_CTRL=y

# --- Shell Configuration ---
CONFIG_SHELL=y
CONFIG_SHELL_BACKEND_SERIAL=y
CONFIG_SHELL_AUTOSTART=y

# --- C Library (Still required) ---
CONFIG_NEWLIB_LIBC=y
CONFIG_NEWLIB_LIBC_FLOAT_PRINTF=y
```

## app.overlay
```dts
/*
 * =================================================================
 * ==                 STEP 1: USB & SHELL TEST                  ==
 * =================================================================
 */
/ {
    chosen {
        zephyr,console = &cdc_acm_uart;
        zephyr,shell-uart = &cdc_acm_uart;
    };
};

&zephyr_udc0 {
    cdc_acm_uart: cdc_acm_uart {
        compatible = "zephyr,cdc-acm-uart";
        label = "CDC_ACM_0";
    };
};
```

## src/main.c
```c
/*
 * =================================================================
 * ==         STEP 1 (Final Test): Zero-Logic main.c            ==
 * =================================================================
 */
#include <zephyr/kernel.h>

// NO LOGGING INCLUDES OR REGISTRATION

int main(void)
{
    // DO ABSOLUTELY NOTHING.
    // The shell is started automatically by CONFIG_SHELL_AUTOSTART.
    // We just need to keep the main thread alive.

    while (1) {
        k_sleep(K_SECONDS(2));
    }

    return 0;
}
```
