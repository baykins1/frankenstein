## prj.conf
```kconfig
# =================================================================
# ==     RTT-based prj.conf for Border Router (RELIABLE)       ==
# =================================================================

# --- Base Features ---
CONFIG_GPIO=y
CONFIG_NETWORKING=y
CONFIG_NET_L2_OPENTHREAD=y
CONFIG_NET_UDP=y
CONFIG_LOG=y
CONFIG_LOG_DEFAULT_LEVEL=3
CONFIG_SETTINGS=y
CONFIG_SETTINGS_NVS=y

# --- Shell Configuration (via RTT) ---
CONFIG_SHELL=y
CONFIG_OPENTHREAD_SHELL=y
CONFIG_SHELL_ARGC_MAX=26
CONFIG_SHELL_CMD_BUFF_SIZE=416

# --- OpenThread Stack ---
CONFIG_OPENTHREAD_NORDIC_LIBRARY_MASTER=y
CONFIG_OPENTHREAD_THREAD_VERSION_1_2=y
CONFIG_OPENTHREAD_FTD=y
CONFIG_OPENTHREAD_MTD=n
CONFIG_OPENTHREAD_BORDER_ROUTER=y

# --- RTT Configuration (Reliable Console) ---
CONFIG_USE_SEGGER_RTT=y
CONFIG_RTT_CONSOLE=y
CONFIG_UART_CONSOLE=n
CONFIG_LOG_BACKEND_RTT=y
CONFIG_SHELL_BACKEND_RTT=y

CONFIG_SHELL_BACKEND_RTT_BUFFER=0
CONFIG_LOG_BACKEND_RTT_BUFFER=1

# --- Disable USB (causes issues) ---
CONFIG_USB_DEVICE_STACK=n

# --- Stack Sizes ---
CONFIG_MAIN_STACK_SIZE=4096
CONFIG_SYSTEM_WORKQUEUE_STACK_SIZE=4096
CONFIG_SHELL_STACK_SIZE=4096
CONFIG_IDLE_STACK_SIZE=1024

# --- Debug and Stability ---
CONFIG_ASSERT=y
CONFIG_NRF_APPROTECT_LOCK=n

# --- Thread Safety ---
CONFIG_THREAD_RUNTIME_STATS=y
```

## app.overlay
```dts
/*
 * =================================================================
 * ==       FINAL, VERIFIED app.overlay for nRF52840DK BR         ==
 * =================================================================
 */
/ {
    /* The 'chosen' node directs key kernel functions to specific hardware. */
    chosen {
        /* Route all console and shell output to the USB Virtual COM port. */
        zephyr,console = &cdc_acm_uart;
        zephyr,shell-uart = &cdc_acm_uart;
    };
};

/* Define the USB CDC ACM UART device itself. */
&zephyr_udc0 {
    cdc_acm_uart: cdc_acm_uart {
        compatible = "zephyr,cdc-acm-uart";
        label = "CDC_ACM_0";
    };
};
```

## src/main.c
```c
/*
 * =================================================================
 * ==          RTT-based Border Router Main                       ==
 * =================================================================
 */
#include <zephyr/kernel.h>
#include <zephyr/device.h>
#include <zephyr/devicetree.h>
#include <zephyr/drivers/gpio.h>
#include <zephyr/logging/log.h>

#include <zephyr/net/openthread.h>
#include <openthread/udp.h>
#include <openthread/message.h>
#include <openthread/border_router.h>
#include <openthread/thread_ftd.h>

LOG_MODULE_REGISTER(ot_border_router, CONFIG_LOG_DEFAULT_LEVEL);

// --- Network Port Definitions ---
#define NODE_COMMAND_PORT   1236
#define HELLO_LISTENER_PORT 1235

// --- State management ---
static bool reporting_is_active = false;
static struct openthread_state_changed_cb ot_state_changed_cb_obj;

// --- GPIO device definitions ---
static const struct gpio_dt_spec button = GPIO_DT_SPEC_GET(DT_ALIAS(sw0), gpios);
static const struct gpio_dt_spec led = GPIO_DT_SPEC_GET(DT_ALIAS(led0), gpios);
static struct gpio_callback button_cb_data;

// --- UDP listener ---
static otUdpSocket hello_socket;

void hello_receive_callback(void *aContext, otMessage *aMessage, const otMessageInfo *aMessageInfo) {
    OT_UNUSED_VARIABLE(aContext);
    char message_buffer[32];
    char sender_addr_str[40];
    int length = otMessageRead(aMessage, otMessageGetOffset(aMessage), message_buffer, sizeof(message_buffer) - 1);
    message_buffer[length] = '\0';
    otIp6AddressToString(&aMessageInfo->mPeerAddr, sender_addr_str, sizeof(sender_addr_str));
    LOG_INF("Received data: '%s' from node %s", message_buffer, sender_addr_str);
    otMessageFree(aMessage);
}

void setup_hello_listener(void) {
    otError error;
    otSockAddr sockaddr;
    otInstance *p_ot_instance = openthread_get_default_instance();
    memset(&sockaddr, 0, sizeof(sockaddr));
    sockaddr.mPort = HELLO_LISTENER_PORT;
    error = otUdpOpen(p_ot_instance, &hello_socket, hello_receive_callback, NULL);
    if (error != OT_ERROR_NONE) { LOG_ERR("Failed to open hello UDP socket: %d", error); return; }
    error = otUdpBind(p_ot_instance, &hello_socket, &sockaddr, OT_NETIF_THREAD);
    if (error != OT_ERROR_NONE) { LOG_ERR("Failed to bind hello UDP socket: %d", error); return; }
    LOG_INF("Hello message listener started successfully on port %d", HELLO_LISTENER_PORT);
}

// --- UDP command sender ---
void send_node_command(const char *command) {
    otError error;
    otMessage *message;
    otMessageInfo messageInfo;
    otInstance *p_ot_instance = openthread_get_default_instance();
    otUdpSocket udpSocket;
    memset(&messageInfo, 0, sizeof(messageInfo));
    otIp6AddressFromString("ff03::1", &messageInfo.mPeerAddr);
    messageInfo.mPeerPort = NODE_COMMAND_PORT;
    message = otUdpNewMessage(p_ot_instance, NULL);
    if (message == NULL) { LOG_ERR("Failed to allocate new UDP message."); return; }
    error = otMessageAppend(message, command, strlen(command));
    if (error != OT_ERROR_NONE) { otMessageFree(message); return; }
    error = otUdpOpen(p_ot_instance, &udpSocket, NULL, NULL);
    if (error != OT_ERROR_NONE) { otMessageFree(message); return; }
    error = otUdpSend(p_ot_instance, &udpSocket, message, &messageInfo);
    if (error != OT_ERROR_NONE) {
        LOG_ERR("Failed to send UDP command: %d", error);
    } else {
        LOG_INF("Command '%s' sent to all nodes.", command);
    }
    otUdpClose(p_ot_instance, &udpSocket);
}

// --- Button press callback ---
void button_pressed(const struct device *dev, struct gpio_callback *cb, uint32_t pins) {
    reporting_is_active = !reporting_is_active;
    if (reporting_is_active) {
        LOG_INF("Button pressed: STARTING data collection.");
        gpio_pin_set_dt(&led, 1);
        send_node_command("start");
    } else {
        LOG_INF("Button pressed: STOPPING data collection.");
        gpio_pin_set_dt(&led, 0);
        send_node_command("stop");
    }
}

// --- OpenThread state change callback ---
static void on_thread_state_changed(otChangedFlags flags, struct openthread_context *ot_context, void *user_data) {
    ARG_UNUSED(user_data);
    if (flags & OT_CHANGED_THREAD_ROLE) {
        otDeviceRole role = otThreadGetDeviceRole(ot_context->instance);
        if ((role == OT_DEVICE_ROLE_LEADER) || (role == OT_DEVICE_ROLE_ROUTER)) {
            LOG_INF("Network is UP! Device role: %d. Initializing UDP listener.", role);
            setup_hello_listener();
        }
    }
}

int main(void)
{
    LOG_INF("Starting Border Router Application");

    // --- Initialize GPIO ---
    if (!device_is_ready(led.port)) { LOG_ERR("LED device not ready"); return -1; }
    if (gpio_pin_configure_dt(&led, GPIO_OUTPUT_INACTIVE) < 0) { LOG_ERR("Failed to configure LED"); return -1; }

    if (!device_is_ready(button.port)) { LOG_ERR("Button device not ready"); return -1; }
    if (gpio_pin_configure_dt(&button, GPIO_INPUT) < 0) { LOG_ERR("Failed to configure button"); return -1; }
    if (gpio_pin_interrupt_configure_dt(&button, GPIO_INT_EDGE_TO_ACTIVE) < 0) { LOG_ERR("Failed to configure button interrupt"); return -1; }
    
    gpio_init_callback(&button_cb_data, button_pressed, BIT(button.pin));
    gpio_add_callback(button.port, &button_cb_data);
    LOG_INF("Button and LED initialized.");

    // --- Register state change handler ---
    ot_state_changed_cb_obj.state_changed_cb = on_thread_state_changed;
    openthread_state_changed_cb_register(openthread_get_default_context(), &ot_state_changed_cb_obj);

    // --- Start OpenThread ---
    if (openthread_start(openthread_get_default_context()) != 0) {
        LOG_ERR("Failed to start OpenThread");
        return -1;
    }

    // --- Configure Border Router Prefix ---
    otBorderRouterConfig config;
    otIp6Address prefix;
    otIp6AddressFromString("fd11:22::", &prefix);
    memset(&config, 0, sizeof(otBorderRouterConfig));
    config.mPrefix.mPrefix = prefix;
    config.mPrefix.mLength = 64;
    config.mPreferred = true;
    config.mSlaac = true;
    config.mOnMesh = true;
    config.mStable = true;
    config.mDefaultRoute = true;
    otBorderRouterAddOnMeshPrefix(openthread_get_default_instance(), &config);
    LOG_INF("Border Router configured. Waiting for network to form...");

    // --- Main Loop ---
    while(1) {
        k_sleep(K_SECONDS(5));
        // Print status periodically
        otDeviceRole role = otThreadGetDeviceRole(openthread_get_default_instance());
        LOG_INF("Current role: %d, Reporting active: %s", role, reporting_is_active ? "YES" : "NO");
    }

    return 0; // Unreachable
}
```
